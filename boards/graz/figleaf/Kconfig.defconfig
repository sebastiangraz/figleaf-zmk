## boards/graz/figleaf/Kconfig.defconfig
```kconfig
if BOARD_FIGLEAF_LEFT

config ZMK_KEYBOARD_NAME
    default "Figleaf"

config ZMK_SPLIT_ROLE_CENTRAL
    default y

endif # BOARD_FIGLEAF_LEFT

if BOARD_FIGLEAF_LEFT || BOARD_FIGLEAF_RIGHT

config BOARD
    default "figleaf"

config ZMK_SPLIT
    default y

config BT_CTLR
    default BT

if USB

config USB_NRFX
    default y

config USB_DEVICE_STACK
    default y

endif # USB

config ZMK_BATTERY_NRF_VDDH
    default y

endif # BOARD_FIGLEAF_LEFT || BOARD_FIGLEAF_RIGHT
```

## boards/graz/figleaf/board.yml
```yaml
boards:
  - name: figleaf_left
    vendor: graz
    socs:
      - name: nrf52840
        variants:
          - name: zmk
  - name: figleaf_right
    vendor: graz
    socs:
      - name: nrf52840
        variants:
          - name: zmk
```

## boards/graz/figleaf/figleaf_right_nrf52840_zmk_defconfig
```kconfig
# Enable MPU
CONFIG_ARM_MPU=y

# Enable GPIO
CONFIG_GPIO=y
CONFIG_PINCTRL=y

# Enable writing to flash
CONFIG_USE_DT_CODE_PARTITION=y
CONFIG_MPU_ALLOW_FLASH_WRITE=y
CONFIG_NVS=y
CONFIG_SETTINGS_NVS=y
CONFIG_FLASH=y
CONFIG_FLASH_PAGE_LAYOUT=y
CONFIG_FLASH_MAP=y

# 32.768 kHz crystal (integrated in the MK08 module)
CONFIG_CLOCK_CONTROL_NRF_K32SRC_XTAL=y
CONFIG_CLOCK_CONTROL_NRF_K32SRC_150PPM=y

# Misc configuration
CONFIG_BT_CTLR_TX_PWR_PLUS_8=y
CONFIG_BUILD_OUTPUT_UF2=y
CONFIG_ZMK_USB=y
CONFIG_ZMK_BLE=y
```

## boards/shields/figleaf/Kconfig.defconfig
```kconfig
if SHIELD_FIGLEAF_LEFT

config ZMK_KEYBOARD_NAME
    default "Figleaf"

config ZMK_SPLIT_ROLE_CENTRAL
    default y

endif # SHIELD_FIGLEAF_LEFT

if SHIELD_FIGLEAF_LEFT || SHIELD_FIGLEAF_RIGHT

config ZMK_SPLIT
    default y

endif # SHIELD_FIGLEAF_LEFT || SHIELD_FIGLEAF_RIGHT
```

## boards/shields/figleaf/Kconfig.shield
```kconfig
config SHIELD_FIGLEAF_LEFT
    def_bool $(shields_list_contains,figleaf_left)

config SHIELD_FIGLEAF_RIGHT
    def_bool $(shields_list_contains,figleaf_right)
```
